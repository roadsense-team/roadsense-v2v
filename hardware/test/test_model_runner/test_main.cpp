/**
 * ESP32 on-device model runner test.
 *
 * Loads the INT8 TFLite model (via model_data.h), runs inference on
 * the golden vectors from golden_vectors.h, and verifies outputs
 * are within tolerance.
 *
 * Pass condition: all N vectors produce |output - expected| < kTolerance.
 *
 * Build with PlatformIO (env: esp32_test_model_runner — add to platformio.ini).
 * Output on Serial at 115200 baud.
 */

#include <Arduino.h>
#include "inference/ModelRunner.h"
#include "golden_vectors.h"   // generated by step8_esp32_golden_test.py

static ModelRunner g_runner;

void setup() {
    Serial.begin(115200);
    delay(1000);
    Serial.println("\n=== ModelRunner Golden Vector Test ===");

    if (!g_runner.begin()) {
        Serial.println("FATAL: ModelRunner::begin() failed!");
        return;
    }

    int passed = 0;
    int failed = 0;

    for (int i = 0; i < kTestVectors; i++) {
        // Copy from flat C arrays into structured buffers
        const float* ego_ptr  = &kTestEgo[0][0]   + i * kEgoDim;
        const float* peer_ptr = &kTestPeers[0][0][0] + i * kMaxPeers * kPeerFeatureDim;
        const float* mask_ptr = &kTestMask[0][0]  + i * kMaxPeers;

        float peers_buf[kMaxPeers][kPeerFeatureDim];
        memcpy(peers_buf, peer_ptr, kMaxPeers * kPeerFeatureDim * sizeof(float));

        float action = g_runner.infer(ego_ptr, peers_buf, mask_ptr);
        float expected = kTestExpected[i];
        float ae = fabsf(action - expected);

        bool ok = (ae < kTolerance) && (g_runner.lastStatus() == 0);
        if (ok) {
            passed++;
        } else {
            failed++;
            Serial.printf("[FAIL] vector %3d: got=%.5f  expected=%.5f  AE=%.5f\n",
                          i, action, expected, ae);
        }
    }

    Serial.printf("\n--- Results: %d / %d passed ---\n", passed, kTestVectors);
    if (failed == 0) {
        Serial.println("ALL TESTS PASSED");
    } else {
        Serial.printf("%d TESTS FAILED\n", failed);
    }

    g_runner.printArenaUsed();
}

void loop() {
    // nothing
}
